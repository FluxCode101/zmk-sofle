## boards/eyelash/eyelash_sofle/board.yml
```yaml
boards:
  - name: eyelash_sofle_left
    vendor: eyelash
    socs:
      - name: nrf52840
        variants:
          - name: zmk
  - name: eyelash_sofle_right
    vendor: eyelash
    socs:
      - name: nrf52840
        variants:
          - name: zmk
```
